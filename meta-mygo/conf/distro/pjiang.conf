## meta-mygo/conf/distro/pjiang.conf
```bitbake
# Based on poky's distro.
require conf/distro/poky.conf
#
DISTRO_NAME = "pjiang demo distribution"
DISTRO_VERSION = "v0"
DISTRO_CODENAME = "pjiang"
MAINTAINER = "peng jiang <pjiang@xxxxx.com>"
INHERIT += "buildhistory"
BUILDHISTORY_COMMIT = "1"
PREFERRED_VERSION_sysvinit-inittab = "3.0"
```

## meta-mygo/conf/layer.conf
```bitbake
# We have a conf and classes directory, add to BBPATH
BBPATH .= ":${LAYERDIR}"

# We have recipes-* directories, add to BBFILES
BBFILES += "${LAYERDIR}/recipes-*/*/*.bb \
	${LAYERDIR}/recipes-*/*/*.bbappend"

BBFILE_COLLECTIONS += "mygo"
BBFILE_PATTERN_mygo = "^${LAYERDIR}/"
BBFILE_PRIORITY_mygo = "6"
IMAGE_INSTALL_append = "  mygo"
```
